/*
 * Copyright (c) 2020 Pete Johanson
 *
 * SPDX-License-Identifier: MIT
 */

#include "corne.dtsi"

&default_transform {
	col-offset = <5>;
};

&kscan0 {
        col-gpios
            = <&pro_micro 14 GPIO_ACTIVE_HIGH>
            , <&pro_micro 15 GPIO_ACTIVE_HIGH>
            , <&pro_micro 18 GPIO_ACTIVE_HIGH>
            , <&pro_micro 19 GPIO_ACTIVE_HIGH>
            , <&pro_micro 20 GPIO_ACTIVE_HIGH>
            ;
};

&nice_nano_spi {
    /*
        1 -> sck -> P0.06 -> left 1
        2 -> miso -> P0.17 -> left 5
        3 -> cs -> P0.08 -> left 2
        4 -> dr -> P1.04 -> left 11
        5 -> mosi -> P0.20 -> left 6
        11 -> gnd -> left 3, left 4, right 2
        12 -> vdd -> right 4
    */
    status = "disabled";
    miso-pin = <17>; // P0.17
    mosi-pin = <20>; // P0.20
    sck-pin = <6>; // P0.6
    cs-gpios = <&gpio0 8 GPIO_ACTIVE_LOW>; // P0.8

    trackpad: trackpad@0 {
        compatible = "cirque,pinnacle";
        status = "disabled";
        reg = <0>;
        label = "Cirque Trackpad";
        spi-max-frequency = <10000000>;
        dr-gpios = <&gpio1 4 GPIO_ACTIVE_HIGH>; // P1.04
        invert-y;
        sleep;
        /* no-taps; */
    };
};